## conf/layer.conf
```bitbake
# We have a conf and classes directory, add to BBPATH
BBPATH .= ":${LAYERDIR}"

# We have recipes-* directories, add to BBFILES
BBFILES += "${LAYERDIR}/recipes-*/*/*.bb \
            ${LAYERDIR}/recipes-*/*/*.bbappend"

BBFILE_COLLECTIONS += "meta-annMedics"
BBFILE_PATTERN_meta-annMedics = "^${LAYERDIR}/"
BBFILE_PRIORITY_meta-annMedics = "6"

LAYERDEPENDS_meta-annMedics = "core"
LAYERSERIES_COMPAT_meta-annMedics = "dunfell"
```
